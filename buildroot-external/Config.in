## buildroot-external/Config.in
```kconfig
source "$BR2_EXTERNAL_MICRONUX_PATH/package/micronux-selftest/Config.in"
source "$BR2_EXTERNAL_MICRONUX_PATH/package/micronux-netctl/Config.in"
source "$BR2_EXTERNAL_MICRONUX_PATH/package/micronux-device-service/Config.in"
source "$BR2_EXTERNAL_MICRONUX_PATH/package/micronux-job-supervisor/Config.in"
source "$BR2_EXTERNAL_MICRONUX_PATH/package/micronux-ignitevm/Config.in"
source "$BR2_EXTERNAL_MICRONUX_PATH/package/micronux-isolation-test/Config.in"
source "$BR2_EXTERNAL_MICRONUX_PATH/package/micronux-display-test/Config.in"
source "$BR2_EXTERNAL_MICRONUX_PATH/package/esp-hosted-fg/Config.in"
```

## buildroot-external/configs/micronux_esp32p4_combined_defconfig
```kconfig
BR2_riscv=y
BR2_riscv_custom=y
BR2_RISCV_ISA_RVM=y
BR2_RISCV_ISA_RVA=y
BR2_RISCV_32=y
# BR2_RISCV_USE_MMU is not set
BR2_RISCV_ISA_RVC=y
# BR2_RISCV_ISA_RVF is not set
# BR2_RISCV_ISA_RVD is not set
BR2_RISCV_ABI_ILP32=y
BR2_PACKAGE_HOST_LINUX_HEADERS_CUSTOM_6_12=y
BR2_TOOLCHAIN_BUILDROOT_UCLIBC=y
BR2_GLOBAL_PATCH_DIR="board/qemu/patches $(BR2_EXTERNAL_MICRONUX_PATH)/board/micronux/patches"
BR2_DOWNLOAD_FORCE_CHECK_HASHES=y
BR2_REPRODUCIBLE=y
BR2_TARGET_GENERIC_HOSTNAME="micronux"
BR2_TARGET_GENERIC_ISSUE="MicroNUX M6 microSD plus ESP32-C6 SDIO"
BR2_INIT_NONE=y
BR2_ROOTFS_DEVICE_CREATION_STATIC=y
BR2_ROOTFS_OVERLAY="$(BR2_EXTERNAL_MICRONUX_PATH)/board/micronux/rootfs-m6 $(BR2_EXTERNAL_MICRONUX_PATH)/board/micronux/rootfs-m6-network $(BR2_EXTERNAL_MICRONUX_PATH)/board/micronux/rootfs-m6-combined"
BR2_PACKAGE_BUSYBOX_CONFIG_FRAGMENT_FILES="board/canaan/k210-soc/busybox-tiny.config $(BR2_EXTERNAL_MICRONUX_PATH)/board/micronux/busybox-m1.config $(BR2_EXTERNAL_MICRONUX_PATH)/board/micronux/busybox-m3.config $(BR2_EXTERNAL_MICRONUX_PATH)/board/micronux/busybox-m4.config $(BR2_EXTERNAL_MICRONUX_PATH)/board/micronux/busybox-m6.config $(BR2_EXTERNAL_MICRONUX_PATH)/board/micronux/busybox-m6-network.config"
BR2_PACKAGE_MICRONUX_SELFTEST=y
BR2_PACKAGE_MICRONUX_NETCTL=y
BR2_LINUX_KERNEL_EXT_ESP_HOSTED_FG=y
# BR2_PACKAGE_IFUPDOWN_SCRIPTS is not set
BR2_LINUX_KERNEL=y
BR2_LINUX_KERNEL_CUSTOM_VERSION=y
BR2_LINUX_KERNEL_CUSTOM_VERSION_VALUE="6.12.27"
BR2_LINUX_KERNEL_USE_CUSTOM_CONFIG=y
BR2_LINUX_KERNEL_CUSTOM_CONFIG_FILE="$(BR2_EXTERNAL_MICRONUX_PATH)/board/micronux/linux-m6-combined.config"
BR2_LINUX_KERNEL_DTS_SUPPORT=y
BR2_LINUX_KERNEL_CUSTOM_DTS_DIR="$(BR2_EXTERNAL_MICRONUX_PATH)/board/micronux/dts-m6-combined"
BR2_TARGET_ROOTFS_INITRAMFS=y
```

## buildroot-external/configs/micronux_esp32p4_shell_defconfig
```kconfig
BR2_riscv=y
BR2_riscv_custom=y
BR2_RISCV_ISA_RVM=y
BR2_RISCV_ISA_RVA=y
BR2_RISCV_32=y
# BR2_RISCV_USE_MMU is not set
BR2_RISCV_ISA_RVC=y
# BR2_RISCV_ISA_RVF is not set
# BR2_RISCV_ISA_RVD is not set
BR2_RISCV_ABI_ILP32=y
BR2_PACKAGE_HOST_LINUX_HEADERS_CUSTOM_6_12=y
BR2_TOOLCHAIN_BUILDROOT_UCLIBC=y
BR2_GLOBAL_PATCH_DIR="board/qemu/patches $(BR2_EXTERNAL_MICRONUX_PATH)/board/micronux/patches"
BR2_DOWNLOAD_FORCE_CHECK_HASHES=y
BR2_REPRODUCIBLE=y
BR2_TARGET_GENERIC_HOSTNAME="micronux"
BR2_TARGET_GENERIC_ISSUE="MicroNUX M4 on ESP32-P4"
BR2_INIT_NONE=y
BR2_ROOTFS_DEVICE_CREATION_STATIC=y
BR2_ROOTFS_OVERLAY="$(BR2_EXTERNAL_MICRONUX_PATH)/board/micronux/rootfs-m4"
BR2_PACKAGE_BUSYBOX_CONFIG_FRAGMENT_FILES="board/canaan/k210-soc/busybox-tiny.config $(BR2_EXTERNAL_MICRONUX_PATH)/board/micronux/busybox-m1.config $(BR2_EXTERNAL_MICRONUX_PATH)/board/micronux/busybox-m3.config $(BR2_EXTERNAL_MICRONUX_PATH)/board/micronux/busybox-m4.config"
# BR2_PACKAGE_IFUPDOWN_SCRIPTS is not set
BR2_LINUX_KERNEL=y
BR2_LINUX_KERNEL_CUSTOM_VERSION=y
BR2_LINUX_KERNEL_CUSTOM_VERSION_VALUE="6.12.27"
BR2_LINUX_KERNEL_USE_CUSTOM_CONFIG=y
BR2_LINUX_KERNEL_CUSTOM_CONFIG_FILE="$(BR2_EXTERNAL_MICRONUX_PATH)/board/micronux/linux-m4.config"
BR2_LINUX_KERNEL_DTS_SUPPORT=y
BR2_LINUX_KERNEL_CUSTOM_DTS_DIR="$(BR2_EXTERNAL_MICRONUX_PATH)/board/micronux/dts-m4"
BR2_TARGET_ROOTFS_INITRAMFS=y
```

## buildroot-external/package/esp-hosted-fg/Config.in
```kconfig
config BR2_PACKAGE_ESP_HOSTED_FG
	bool "esp-hosted-fg"
	depends on BR2_LINUX_KERNEL
	help
	  Pinned Espressif ESP-Hosted-FG source used by the MicroNUX Linux
	  kernel extension. The driver is linked into the ESP32-P4 NOMMU
	  kernel and exposes the C6 station/AP data paths as Ethernet devices.
```

## buildroot-external/package/micronux-device-service/Config.in
```kconfig
config BR2_PACKAGE_MICRONUX_DEVICE_SERVICE
	bool "micronux-device-service"
	help
	  Versioned local device-service ABI, policy daemon, shell client,
	  native C SDK, and acceptance tests for MicroNUX.
```

## buildroot-external/package/micronux-display-test/Config.in
```kconfig
config BR2_PACKAGE_MICRONUX_DISPLAY_TEST
	bool "micronux-display-test"
	depends on !BR2_USE_MMU
	help
	  No-LVGL M9 acceptance client for the Linux-owned framebuffer and
	  GT9271 input device. It validates the public interfaces, acquires
	  graphics console ownership, performs positioned framebuffer writes,
	  and runs the five-point Kit C touch gate.
```

## buildroot-external/package/micronux-ignitevm/Config.in
```kconfig
config BR2_PACKAGE_MICRONUX_IGNITEVM
	bool "micronux-ignitevm"
	select BR2_PACKAGE_CJSON
	select BR2_PACKAGE_MICRONUX_DEVICE_SERVICE
	help
	  Linux userspace runner for real IgniteVM IGPK packages. The build
	  requires MICRONUX_IGNITEVM_SOURCE_DIR to name an IgniteVM source
	  checkout with the portable host support used by MicroNUX.
```

## buildroot-external/package/micronux-isolation-test/Config.in
```kconfig
config BR2_PACKAGE_MICRONUX_ISOLATION_TEST
	bool "micronux-isolation-test"
	depends on !BR2_USE_MMU
	help
	  Hardware-only bFLT probes for the MicroNUX reserved user pool,
	  U-visible VMA ownership contract, PMP fault boundary, and syscall
	  pointer validation.
```

## buildroot-external/package/micronux-jd9365-firmware/Config.in
```kconfig
config BR2_PACKAGE_MICRONUX_JD9365_FIRMWARE
	bool "micronux-jd9365-firmware"
	help
	  Install the separately licensed Waveshare JD9365 10.1-inch panel
	  DCS command program used by the native MicroNUX display driver.
	  The artifact contains bounded command/data/delay records only; it
	  cannot perform arbitrary ESP32-P4 register writes.
```

## buildroot-external/package/micronux-job-supervisor/Config.in
```kconfig
config BR2_PACKAGE_MICRONUX_JOB_SUPERVISOR
	bool "micronux-job-supervisor"
	depends on !BR2_USE_MMU
	select BR2_PACKAGE_MICRONUX_DEVICE_SERVICE
	help
	  Root-owned launcher and policy helper for bounded, non-root
	  MicroNUX native and IgniteVM application jobs.
```

## buildroot-external/package/micronux-netctl/Config.in
```kconfig
config BR2_PACKAGE_MICRONUX_NETCTL
	bool "micronux-netctl"
	help
	  Minimal ESP-Hosted-MCU control-plane client for MicroNUX.
```

## buildroot-external/package/micronux-selftest/Config.in
```kconfig
config BR2_PACKAGE_MICRONUX_SELFTEST
	bool "micronux-selftest"
	depends on !BR2_USE_MMU
	help
	  Native bFLT hardening test for the MicroNUX NOMMU process,
	  signal, timer, memory, stack, and console contracts.
```

## loader/main/Kconfig.projbuild
```kconfig
menu "MicroNUX loader profile"

    config MICRONUX_M7_EARLY_UMODE_DENY
        bool "Install the M7 pre-v3 U-mode deny PMP baseline"
        depends on IDF_TARGET_ESP32P4
        depends on ESP32P4_SELECTS_REV_LESS_V3
        depends on !ESP_SYSTEM_MEMPROT
        default n
        help
            Select only with the tracked MicroNUX ESP-IDF v6.0.1 patch.
            Before app_main(), CPU-control, internal RAM, ROM/flash, LP-memory,
            and peripheral regions become unlocked PMP deny entries. M-mode
            remains able to access them. Entries 7-10 and 12 stay free, and
            the Linux handoff pair at 13-14 stays unlocked, so Linux can
            install its verified U-return rules. The loader audits all 16
            entries and refuses handoff on any mismatch.

    config MICRONUX_M9_JD9365_COLD_RELINQUISH
        bool "Relinquish a cold JD9365 display to M9 Linux"
        depends on IDF_TARGET_ESP32P4
        depends on ESP32P4_SELECTS_REV_LESS_V3
        depends on !ESP_SYSTEM_MEMPROT
        select MICRONUX_M7_EARLY_UMODE_DENY
        default n
        help
            Prepare only the Waveshare 10.1-inch 800x1280 JD9365 resource
            contract for native Linux cold initialization. The loader sends
            acknowledged PWM-zero, reset-prepare, and reset-assert
            commands to the write-only external controller, leaves the D-PHY
            LDO, DSI host/bridge, and GDMA quiescent, reserves cleared
            framebuffer and descriptor storage, and commits ABI v3 only as
            the final write before the Linux jump. It never creates an
            ESP-IDF panel, starts scanout, or draws a splash.

    config MICRONUX_C6_SDIO_PROFILE
        bool "Prepare ESP32-C6 SDIO slot 1 instead of microSD slot 0"
        default n
        help
            Select the independent M6 networking profile. The loader resets
            the onboard ESP32-C6, routes its four-bit SDIO bus through the
            GPIO matrix, and hands DesignWare MSHC slot 1 to Linux. The
            default storage profile remains slot 0 and does not reset the C6.

    config MICRONUX_SDMMC_DUAL_SLOT_PROFILE
        bool "Prepare both microSD slot 0 and ESP32-C6 SDIO slot 1"
        depends on MICRONUX_C6_SDIO_PROFILE
        default n
        help
            Extend the C6 profile with the onboard microSD connector. The
            loader powers and routes both physical slots, then Linux owns the
            shared controller and serializes requests between storage and
            networking. Leave disabled for the isolated C6 regression profile.

    config MICRONUX_C6_PROVISIONING
        bool "Provision Wi-Fi through the factory ESP32-C6 before Linux"
        depends on MICRONUX_C6_SDIO_PROFILE
        default n
        help
            Run Espressif Unified Provisioning on the ESP32-P4 host before
            Linux. The factory ESP32-C6 remains the ESP-Hosted slave on SDIO.
            An unprovisioned device advertises over BLE, falls back to SoftAP
            while idle, stores Wi-Fi configuration in the C6, and reboots
            before the Linux handoff. Protocomm Security 2 is mandatory.

    config MICRONUX_MIPI_DSI
        bool "Enable the MIPI-DSI electrical proof profile"
        depends on !MICRONUX_M9_JD9365_COLD_RELINQUISH
        default n
        help
            Initialize one explicitly selected Waveshare MIPI-DSI panel and
            show the ESP32-P4 hardware vertical color-bar pattern before the
            Linux handoff. The scanout buffer stays in the loader-owned PSRAM
            reservation; this option does not grant Linux framebuffer
            ownership. Select only the exact attached panel profile.

    config MICRONUX_DISPLAY_STANDALONE
        bool "Keep the JD9365 display owned by ESP-IDF"
        depends on MICRONUX_MIPI_DSI
        depends on MICRONUX_MIPI_PANEL_JD9365_800_1280
        default n
        help
            Run a Linux-free display baseline. ESP-IDF initializes the exact
            Waveshare 10.1-inch JD9365 panel, shows hardware color bars, then
            continuously refreshes a static MicroNUX status page. The loader
            does not inspect or load the Linux payload and does not initialize
            SD/MMC or the ESP32-C6 transport.

    config MICRONUX_MIPI_DSI_PROBE
        bool "Probe for a MIPI display adapter without powering the panel"
        depends on !MICRONUX_MIPI_DSI
        depends on !MICRONUX_M9_JD9365_COLD_RELINQUISH
        default n
        help
            Check only whether the Waveshare display adapter acknowledges at
            I2C address 0x45. The probe performs no I2C register writes, does
            not enable the panel rail, D-PHY, scanout, or backlight, and
            releases the I2C controller before Linux handoff. An ACK proves
            attachment, not the panel controller model; the physical label is
            still required before selecting an electrical proof profile.

    if MICRONUX_MIPI_DSI

        choice MICRONUX_MIPI_PANEL
            prompt "Attached Waveshare MIPI-DSI panel"
            default MICRONUX_MIPI_PANEL_UNSELECTED
            help
                The controller, resolution, timing, and lane rate must match
                the exact attached panel. The safe default refuses to power
                the D-PHY, panel, or backlight.

            config MICRONUX_MIPI_PANEL_UNSELECTED
                bool "No panel selected (refuse to power display)"

            config MICRONUX_MIPI_PANEL_JD9365_800_1280
                bool "JD9365 800x1280 (10.1-DSI-TOUCH-A, Kit C)"

            config MICRONUX_MIPI_PANEL_ILI9881C_720_1280
                bool "ILI9881C 720x1280 (7-inch DSI Touch A)"

            config MICRONUX_MIPI_PANEL_HX8394_720_1280
                bool "HX8394 720x1280 (5-inch DSI Touch A)"

            config MICRONUX_MIPI_PANEL_EK79007_1024_600
                bool "EK79007 1024x600 (7-inch DSI Touch C)"

        endchoice

        config MICRONUX_MIPI_BACKLIGHT_PERCENT
            int "Diagnostic backlight brightness percent"
            range 1 100
            default 25
            help
                Backlight level applied only after panel initialization and
                the hardware color-bar generator both succeed.

    endif

endmenu
```
